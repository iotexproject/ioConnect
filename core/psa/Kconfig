## core/src/hal/Kconfig
```kconfig
mainmenu "W3B Stream SDK Config"

menuconfig ENABLE_HAL_SUPPORT
    bool "Hardware Abstraction Layer (HAL)"
    depends on PSA_KEY_STORAGE_C

if ENABLE_HAL_SUPPORT

    choice PLATFORM_TYPE
    prompt "Select Platform Type"

        config PLATFORM_ARDUINO
            bool "Support Arduino Platform"

        config PLATFORM_ESPRESSIF
            bool "Support ESPRESSIF Platform"

        config PLATFORM_LINUX
            bool "Support Linux Platform"
    
    endchoice

    choice SOC_TYPE
        prompt "Select SoC Type"
    
        config SOC_ESP32_SUPPORT
            bool "Support ESP32 SoC"
    
        config SOC_ESP8266_SUPPORT
            bool "Support ESP8266 SoC"
            
    endchoice
endif
```

## core/src/utils/Kconfig
```kconfig
mainmenu "W3B Stream SDK Config"

menu "Applications"

    menuconfig APP_DEVNET_ACCESS
        bool "Enable Devnet Access Application"

    if APP_DEVNET_ACCESS

        menu "Device Token"
            
            config APP_DEVNET_ACCESS_STUDIO_TOKEN
                string ""

        endmenu

        choice DEVNET_ACCESS_TYPE
        prompt "Select Access Type"
        
            config APP_DEVNET_ACCESS_MQTT
                bool "MQTT"
            
            config APP_DEVNET_ACCESS_HTTP
                bool "HTTP"

        endchoice

        menu "MQTT TOPIC"
            depends on APP_DEVNET_ACCESS_MQTT

            config APP_DEVNET_ACCESS_STUDIO_TOPIC
                string ""
            
        endmenu

        menu "MQTT URL"
            depends on APP_DEVNET_ACCESS_MQTT

            config APP_DEVNET_ACCESS_STUDIO_URL
                string ""
                default "devnet-staging-mqtt.w3bstream.com"

        endmenu

        menu "HTTP Route"
            depends on APP_DEVNET_ACCESS_HTTP

            config APP_DEVNET_ACCESS_STUDIO_ROUTE
                string "Devnet HTTP Route"

            
        endmenu

        menu "Reported Data Format"

            config SUPPORT_JSON_FORMAT
                bool "Support JSON Format"
                default y

            config SUPPORT_PB_FORMAT
                bool "Support Protobuf Format"
                default y

            config SUPPORT_RAW_FORMAT
                bool "Support RAW Format"
                default y
                
        endmenu

    endif

endmenu
```
